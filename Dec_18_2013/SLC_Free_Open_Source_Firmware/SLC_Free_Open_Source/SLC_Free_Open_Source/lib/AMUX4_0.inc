;;*****************************************************************************
;;*****************************************************************************
;;  FILENAME:   AMUX4_0.inc
;;  Version: 1.50, Updated on 2012/9/21 at 11:56:52
;;  Generated by PSoC Designer 5.3.2710
;;
;;  DESCRIPTION:  Assembler declarations for the MUX4 user module interface.
;;-----------------------------------------------------------------------------
;;  Copyright (c) Cypress Semiconductor 2012. All Rights Reserved.
;;*****************************************************************************
;;*****************************************************************************

;--------------------------------------------------
; Constants for AMUX4_0 API's.
;--------------------------------------------------
AMUX4_0_MUX_COL:             equ (0h & 03h)
AMUX4_0_COL_COUNT:           equ (0h & 80h)
AMUX4_0_MUX_MASK:            equ (03 << (0h<<1))

AMUX4_0_PORT0_0:                  equ 0h
AMUX4_0_PORT0_2:                  equ 1h
AMUX4_0_PORT0_4:                  equ 2h
AMUX4_0_PORT0_6:                  equ 3h

AMUX4_0_PORT0_1:                  equ 0h
AMUX4_0_PORT0_3:                  equ 1h
AMUX4_0_PORT0_5:                  equ 2h
AMUX4_0_PORT0_7:                  equ 3h

; end of file AMUX4_0.inc
