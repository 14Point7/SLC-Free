;;*****************************************************************************
;;*****************************************************************************
;;  FILENAME: DAC9_Ia.inc
;;   Version: 2.2, Updated on 2012/9/21 at 11:58:35
;;  Generated by PSoC Designer 5.3.2710
;;
;;  DESCRIPTION:  Assembler declarations for the DAC9 user module interface.
;;
;;-----------------------------------------------------------------------------
;;  Copyright (c) Cypress Semiconductor 2012. All Rights Reserved.
;;*****************************************************************************
;;*****************************************************************************

include "m8c.inc"

;--------------------------------------------------
; Constants for DAC9_Ia API's
;--------------------------------------------------
DAC9_Ia_OFF:              equ 00h
DAC9_Ia_LOWPOWER:         equ 01h
DAC9_Ia_MEDPOWER:         equ 02h
DAC9_Ia_HIGHPOWER:        equ 03h
DAC9_Ia_FULLPOWER:        equ 03h

DAC9_Ia_LSB_CR0:          equ 90h
DAC9_Ia_LSB_CR1:          equ 91h
DAC9_Ia_LSB_CR2:          equ 92h
DAC9_Ia_LSB_CR3:          equ 93h
DAC9_Ia_MSB_CR0:          equ 94h
DAC9_Ia_MSB_CR1:          equ 95h
DAC9_Ia_MSB_CR2:          equ 96h
DAC9_Ia_MSB_CR3:          equ 97h

DAC9_Ia_OffsetBinary:     equ 04h
DAC9_Ia_TwosComplement:   equ 02h
DAC9_Ia_SignAndMagnitude: equ 01h
DAC9_Ia_RawRegister:      equ 00h

DAC9_Ia_DATAFORMAT:       equ 7h
DAC9_Ia_OFFSETBINARY:     equ DAC9_Ia_DATAFORMAT & DAC9_Ia_OffsetBinary
DAC9_Ia_TWOSCOMPLEMENT:   equ DAC9_Ia_DATAFORMAT & DAC9_Ia_TwosComplement
DAC9_Ia_SIGNANDMAGNITUDE: equ DAC9_Ia_DATAFORMAT & DAC9_Ia_SignAndMagnitude

DAC9_Ia_PHASE_Normal:     equ 0
DAC9_Ia_PHASE_Swapped:    equ 1

DAC9_Ia_PHASE_SWAP:       equ DAC9_Ia_PHASE_Normal

IF DAC9_Ia_PHASE_SWAP
    DAC9_Ia_CR0_HIBITS:   equ C0h
ELSE
    DAC9_Ia_CR0_HIBITS:   equ 80h
ENDIF

;--------------------------------------------------
; Register Address Constants for DAC9_Ia
;--------------------------------------------------
DAC9_Ia_LSB_CR0:    equ 90h                      ; LSB SC Block Control Register 0
DAC9_Ia_LSB_CR1:    equ 91h                      ; LSB SC Block Control Register 1
DAC9_Ia_LSB_CR2:    equ 92h                      ; LSB SC Block Control Register 2
DAC9_Ia_LSB_CR3:    equ 93h                      ; LSB SC Block Control Register 3

DAC9_Ia_MSB_CR0:    equ 94h                      ; MSB SC Block Control Register 0
DAC9_Ia_MSB_CR1:    equ 95h                      ; MSB SC Block Control Register 1
DAC9_Ia_MSB_CR2:    equ 96h                      ; MSB SC Block Control Register 2
DAC9_Ia_MSB_CR3:    equ 97h                      ; MSB SC Block Control Register 3

; end of file DAC9_Ia.inc
