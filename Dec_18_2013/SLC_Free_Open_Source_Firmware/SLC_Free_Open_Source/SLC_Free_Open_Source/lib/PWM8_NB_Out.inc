;;*****************************************************************************
;;*****************************************************************************
;;  FILENAME: PWM8_NB_Out.inc
;;   Version: 2.60, Updated on 2012/9/21 at 11:59:18
;;  Generated by PSoC Designer 5.3.2710
;;
;;  DESCRIPTION: Assembler declarations for the PWM8 user module interface
;;-----------------------------------------------------------------------------
;;  Copyright (c) Cypress Semiconductor 2012. All Rights Reserved.
;;*****************************************************************************
;;*****************************************************************************

include "m8c.inc"


;--------------------------------------------------
; Constants for PWM8_NB_Out API's.
;--------------------------------------------------

PWM8_NB_Out_CONTROL_REG_START_BIT:         equ 0x01    ; Control register start bit
PWM8_NB_Out_INT_REG:                       equ 0x0e1
PWM8_NB_Out_INT_MASK:                      equ 0x08


;--------------------------------------------------
; Constants for PWM8_NB_Out user defined values
;--------------------------------------------------

PWM8_NB_Out_PERIOD:                        equ 0xff
PWM8_NB_Out_PULSE_WIDTH:                   equ 0x00


;--------------------------------------------------
; Register Address Constants for PWM8_NB_Out
;--------------------------------------------------

PWM8_NB_Out_COUNTER_REG:               equ 0x2c   ; DR0 Count register
PWM8_NB_Out_PERIOD_REG:                equ 0x2d   ; DR1 Period register
PWM8_NB_Out_COMPARE_REG:               equ 0x2e   ; DR2 Compare register
PWM8_NB_Out_CONTROL_REG:               equ 0x2f   ; Control register
PWM8_NB_Out_FUNC_REG:                  equ 0x2c   ; Function register
PWM8_NB_Out_INPUT_REG:                 equ 0x2d   ; Input register
PWM8_NB_Out_OUTPUT_REG:                equ 0x2e   ; Output register


;--------------------------------------------------
; PWM8_NB_Out Macro 'Functions'
;--------------------------------------------------

   macro PWM8_NB_Out_Start_M
   or    reg[PWM8_NB_Out_CONTROL_REG],  PWM8_NB_Out_CONTROL_REG_START_BIT
   endm

   macro PWM8_NB_Out_Stop_M
   and   reg[PWM8_NB_Out_CONTROL_REG], ~PWM8_NB_Out_CONTROL_REG_START_BIT
   endm

   macro PWM8_NB_Out_EnableInt_M
   M8C_EnableIntMask PWM8_NB_Out_INT_REG, PWM8_NB_Out_INT_MASK
   endm

   macro PWM8_NB_Out_DisableInt_M
   M8C_DisableIntMask PWM8_NB_Out_INT_REG, PWM8_NB_Out_INT_MASK
   endm


; end of file PWM8_NB_Out.inc
