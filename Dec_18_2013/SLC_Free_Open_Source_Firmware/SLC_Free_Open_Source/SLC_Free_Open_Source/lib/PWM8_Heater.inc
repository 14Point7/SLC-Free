;;*****************************************************************************
;;*****************************************************************************
;;  FILENAME: PWM8_Heater.inc
;;   Version: 2.60, Updated on 2012/9/21 at 11:59:18
;;  Generated by PSoC Designer 5.3.2710
;;
;;  DESCRIPTION: Assembler declarations for the PWM8 user module interface
;;-----------------------------------------------------------------------------
;;  Copyright (c) Cypress Semiconductor 2012. All Rights Reserved.
;;*****************************************************************************
;;*****************************************************************************

include "m8c.inc"


;--------------------------------------------------
; Constants for PWM8_Heater API's.
;--------------------------------------------------

PWM8_Heater_CONTROL_REG_START_BIT:         equ 0x01    ; Control register start bit
PWM8_Heater_INT_REG:                       equ 0x0e1
PWM8_Heater_INT_MASK:                      equ 0x02


;--------------------------------------------------
; Constants for PWM8_Heater user defined values
;--------------------------------------------------

PWM8_Heater_PERIOD:                        equ 0xff
PWM8_Heater_PULSE_WIDTH:                   equ 0x00


;--------------------------------------------------
; Register Address Constants for PWM8_Heater
;--------------------------------------------------

PWM8_Heater_COUNTER_REG:               equ 0x24   ; DR0 Count register
PWM8_Heater_PERIOD_REG:                equ 0x25   ; DR1 Period register
PWM8_Heater_COMPARE_REG:               equ 0x26   ; DR2 Compare register
PWM8_Heater_CONTROL_REG:               equ 0x27   ; Control register
PWM8_Heater_FUNC_REG:                  equ 0x24   ; Function register
PWM8_Heater_INPUT_REG:                 equ 0x25   ; Input register
PWM8_Heater_OUTPUT_REG:                equ 0x26   ; Output register


;--------------------------------------------------
; PWM8_Heater Macro 'Functions'
;--------------------------------------------------

   macro PWM8_Heater_Start_M
   or    reg[PWM8_Heater_CONTROL_REG],  PWM8_Heater_CONTROL_REG_START_BIT
   endm

   macro PWM8_Heater_Stop_M
   and   reg[PWM8_Heater_CONTROL_REG], ~PWM8_Heater_CONTROL_REG_START_BIT
   endm

   macro PWM8_Heater_EnableInt_M
   M8C_EnableIntMask PWM8_Heater_INT_REG, PWM8_Heater_INT_MASK
   endm

   macro PWM8_Heater_DisableInt_M
   M8C_DisableIntMask PWM8_Heater_INT_REG, PWM8_Heater_INT_MASK
   endm


; end of file PWM8_Heater.inc
