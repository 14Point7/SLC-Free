;  Generated by PSoC Designer 5.4.3191
;
; =============================================================================
; FILENAME: PSoCAPI.inc
;  
; Copyright (c) Cypress Semiconductor 2013. All Rights Reserved.
;  
; NOTES:
; Do not modify this file. It is generated by PSoC Designer each time the
; generate application function is run. The values of the parameters in this
; file can be modified by changing the values of the global parameters in the
; device editor.
;  
; =============================================================================
 
include "PSoCGPIOINT.inc"
include "ADCINC.inc"
include "AMUX4_0.inc"
include "AMUX4_1.inc"
include "DAC6_VGND.inc"
include "DAC9_Ia.inc"
include "INSAMP.inc"
include "LCD.inc"
include "PWM8_Heater.inc"
include "PWM8_NB_Out.inc"
include "PWM8_Vout.inc"
include "SleepTimer.inc"
