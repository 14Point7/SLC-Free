;;*****************************************************************************
;;*****************************************************************************
;;  FILENAME: SleepTimer.inc
;;   Version: 1.0, Updated on 2015/3/4 at 22:26:59
;;  Generated by PSoC Designer 5.4.3191
;;
;;  DESCRIPTION: Assembler declarations for the SleepTimer user module interface
;;-----------------------------------------------------------------------------
;;  Copyright (c) Cypress Semiconductor 2015. All Rights Reserved.
;;*****************************************************************************
;;*****************************************************************************

include "m8c.inc"


;--------------------------------------------------
; Constants for SleepTimer API's.
;--------------------------------------------------

SleepTimer_INT_REG:                        equ 0x0e0
SleepTimer_INT_MASK:                       equ 0x40

SleepTimer_TICK_CNTR_SIZE:                  equ  4h

; Frequency of sleep timer interrupts
SleepTimer_1_HZ:                            equ 0x18
SleepTimer_8_HZ:                            equ 0x10
SleepTimer_64_HZ:                           equ 0x08
SleepTimer_512_HZ:                          equ 0x00
SleepTimer_CLOCK_MASK:                      equ 0x18

SleepTimer_FORCE_RELOAD:                    equ 0x01
SleepTimer_WAIT_RELOAD:                     equ 0x00
