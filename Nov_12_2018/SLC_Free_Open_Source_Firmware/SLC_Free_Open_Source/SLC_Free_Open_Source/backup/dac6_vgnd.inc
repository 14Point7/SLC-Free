;;*****************************************************************************
;;*****************************************************************************
;;  FILENAME: DAC6_VGND.inc
;;   Version: 4.3, Updated on 2015/3/4 at 22:25:9
;;  Generated by PSoC Designer 5.4.3191
;;
;;  DESCRIPTION: Assembler declarations for the DAC6 user module interface.
;;
;;-----------------------------------------------------------------------------
;;  Copyright (c) Cypress Semiconductor 2015. All Rights Reserved.
;;*****************************************************************************
;;*****************************************************************************

;--------------------------------------------------
; Constants for DAC6_VGND API's
;--------------------------------------------------
DAC6_VGND_OFF:              equ 00h
DAC6_VGND_LOWPOWER:         equ 01h
DAC6_VGND_MEDPOWER:         equ 02h
DAC6_VGND_HIGHPOWER:        equ 03h

DAC6_VGND_OffsetBinary:     equ 04h
DAC6_VGND_TwosComplement:   equ 02h
DAC6_VGND_SignAndMagnitude: equ 01h
DAC6_VGND_RawRegister:      equ 00h

DAC6_VGND_DATAFORMAT:       equ 7h
DAC6_VGND_OFFSETBINARY:     equ DAC6_VGND_DATAFORMAT & DAC6_VGND_OffsetBinary
DAC6_VGND_TWOSCOMPLEMENT:   equ DAC6_VGND_DATAFORMAT & DAC6_VGND_TwosComplement
DAC6_VGND_SIGNANDMAGNITUDE: equ DAC6_VGND_DATAFORMAT & DAC6_VGND_SignAndMagnitude

DAC6_VGND_PHASE_Normal:     equ 0
DAC6_VGND_PHASE_Swapped:    equ 1
DAC6_VGND_PHASE_SWAP:       equ DAC6_VGND_PHASE_Normal

IF DAC6_VGND_PHASE_SWAP
    DAC6_VGND_CR0_HIBITS:   equ C0h
ELSE
    DAC6_VGND_CR0_HIBITS:   equ 80h
ENDIF


;--------------------------------------------------
; Register Address Constants for DAC6_VGND
;--------------------------------------------------
DAC6_VGND_CR0:              equ 80h
DAC6_VGND_CR1:              equ 81h
DAC6_VGND_CR2:              equ 82h
DAC6_VGND_CR3:              equ 83h
